## main/Kconfig.projbuild
```kconfig
menu "Example Configuration"

    config ESP_WIFI_SSID
        string "WiFi SSID"
        default "myssid"
        help
            SSID (network name) for the example to connect to.

    config ESP_WIFI_PASSWORD
        string "WiFi Password"
        default "mypassword"
        help
            WiFi password (WPA or WPA2) for the example to use.
    config ESP_WIFI_CHANNEL
        int "WiFi Channel"
        range 1 13
        default 1
        help
            WiFi channel (network channel) for the example to use.

    config ESP_MAX_STA_CONN
        int "Maximal STA connections"
        default 4
        help
            Max number of the STA connects to AP.
    
    config EXAMPLE_WEB_MOUNT_POINT
        string "Website mount point in VFS"
        default "/www"
        help
            Specify the mount point in VFS.

    config PARTITION_TABLE_CUSTOM_FILENAME
        string "PARTITION_TABLE_CUSTOM_FILENAME"
        default "partitions_example.csv"
        help
            PARTITION_TABLE_CUSTOM_FILENAME

    config PARTITION_TABLE_FILENAME
        string "PARTITION_TABLE_CUSTOM_FILENAME"
        default "partitions_example.csv"
        help
            PARTITION_TABLE_FILENAME

    config SPIFFS_OBJ_NAME_LEN
        int "SPIFFS_OBJ_NAME_LEN"
        default 128
        help
            SPIFFS_OBJ_NAME_LEN

endmenu
```
